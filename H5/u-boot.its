## H5/u-boot.its
```
/dts-v1/;

/ {
	description = "Configuration to load ATF before U-Boot";
	#address-cells = <1>;

	images {
		uboot@1 {
			description = "U-Boot (64-bit)";
			data = /incbin/("u-boot-nodtb.bin");
			type = "standalone";
			arch = "arm64";
			compression = "none";
			load = <0x4a000000>;
		};
		atf@1 {
			description = "ARM Trusted Firmware";
			data = /incbin/("/dev/null");
			type = "firmware";
			arch = "arm64";
			compression = "none";
			load = <0x44000>;
			entry = <0x44000>;
		};
		fdt@1 {
			description = "sun50i-h5-orangepi-prime";
			data = /incbin/("arch/arm/dts/sun50i-h5-orangepi-prime.dtb");
			type = "flat_dt";
			compression = "none";
		};
	};
	configurations {
		default = "config@1";

		config@1 {
			description = "sun50i-h5-orangepi-prime";
			firmware = "uboot@1";
			loadables = "atf@1";
			fdt = "fdt@1";
		};
	};
};
```
